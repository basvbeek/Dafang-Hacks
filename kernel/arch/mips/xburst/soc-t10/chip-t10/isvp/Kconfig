## kernel/arch/mips/xburst/soc-t10/chip-t10/isvp/Kconfig
```kconfig
choice
	prompt "Board type"
	depends on PLATFORM_T10_ISVP
	default BOARD_MANGO

config BOARD_MANGO
       bool "Mango"
       depends on PLATFORM_T10_ISVP

endchoice

config BOARD_NAME
	string
	default "mango" if BOARD_MANGO
```
